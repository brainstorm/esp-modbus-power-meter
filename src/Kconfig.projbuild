## src/Kconfig.projbuild
```kconfig
menu "Modbus Power Meter settings"
    choice POWER_METER_MODEL
        prompt "Power meter make and model"
        help
            "Selects the power meter model. Please report back if UNTESTED meter works!"
        default POWER_METER_MODEL_YG899E_9SY_2017

        config POWER_METER_MODEL_YG899E_9SY_2017
            bool "Yigedianqi YG899E_9SY_2017"

        config POWER_METER_MODEL_YG899E_9SY_2018
            bool "Yigedianqi YG899E_9SY_2018"

        config POWER_METER_MODEL_YG912_S9Y
            bool "Yigedianqi YG912_S9Y (UNTESTED)"

        config POWER_METER_MODEL_YG914E_95Y
            bool "Yigedianqi YG194E_95Y (UNTESTED)"

        config POWER_METER_MODEL_DDS238_1_ZN
            bool "DDS238_1_ZN (UNTESTED)"

        config POWER_METER_MODEL_PAC3100
            bool "PAC3100 (UNTESTED)"

        config POWER_METER_MODEL_PZEM_016
            bool "PZEM-016 (UNTESTED)"

        config POWER_METER_MODEL_SDM120
            bool "SDM120 (UNTESTED)"

        config POWER_METER_MODEL_SDM220
            bool "SDM220 (UNTESTED)"

        config POWER_METER_MODEL_SDM630
            bool "SDM630 (UNTESTED)"

        config POWER_METER_MODEL_SMART_X96
            bool "SMART-X96 (UNTESTED)"

        config POWER_METER_MODEL_SMART_X96_HARMONIC
            bool "SMART-X96 HARMONIC (UNTESTED)"
    endchoice

    config RMAKER_SERVICE_ENABLE
        bool "Enable Rmaker service"
        default false
        help
            "Enable the Rmaker service. This is a service that allows you to control your power meter from the Espressif's RMaker cloud."

    config PVOUTPUT_ORG_SERVICE_ENABLE
        bool "Enable PVOutput.org service"
        default false
        help
            "Enables the PVOutput.org service. This service will send data to the PVOutput.org service. See https://pvoutput.org/ for more information."

    config PVOUTPUT_ORG_API_KEY
        string "PVOutput.org API Key"
        default "<API KEY HERE>"
        help
            PVOutput.org programmatic API Key used to report current
            power, voltage, etc...
    config PVOUTPUT_ORG_SYSTEM_ID
        string "PVoutput.org System Id"
        default "<SYSTEM_ID_HERE>"
        help
            PVOutput.org specific system id (solar panels) we are monitoring
    config MB_UART_PORT_NUM
        int "UART port number"
        range 0 2 if IDF_TARGET_ESP32 || IDF_TARGET_ESP32S3
        default 2 if IDF_TARGET_ESP32 || IDF_TARGET_ESP32S3
        range 0 1 if IDF_TARGET_ESP32S2 || IDF_TARGET_ESP32C3
        default 1 if IDF_TARGET_ESP32S2 || IDF_TARGET_ESP32C3
        help
            UART communication port number for Modbus.

    choice DEV_PROD_MODE
        prompt "Development/production switch"
        default DEV_MODE
        help
            Avoids unnecessary/wrong calls to third party APIs while developing
            and shortening wait times for (stress) testing purposes.
            **or**
            Set the device to production for the real deal

        config DEV_MODE
            bool "Development mode"

        config PROD_MODE
            bool "Production mode"

    endchoice
    config MB_UART_BAUD_RATE
        int "UART communication speed"
        range 1200 115200
        default 9600
        help
            UART communication speed for Modbus.

    config MB_UART_RXD
        int "UART RXD pin number"
        range 0 34 if IDF_TARGET_ESP32
        default 22 if IDF_TARGET_ESP32
        range 0 46 if IDF_TARGET_ESP32S2
        range 0 47 if IDF_TARGET_ESP32S3
        range 0 19 if IDF_TARGET_ESP32C3
        default 8 if IDF_TARGET_ESP32S2 || IDF_TARGET_ESP32S3 || IDF_TARGET_ESP32C3
        help
            GPIO number for UART RX pin. See UART documentation for more information
            about available pin numbers for UART.

    config MB_UART_TXD
        int "UART TXD pin number"
        range 0 34 if IDF_TARGET_ESP32
        default 23 if IDF_TARGET_ESP32
        range 0 46 if IDF_TARGET_ESP32S2
        range 0 47 if IDF_TARGET_ESP32S3
        range 0 19 if IDF_TARGET_ESP32C3
        default 6 if IDF_TARGET_ESP32S2 || IDF_TARGET_ESP32S3 || IDF_TARGET_ESP32C3
        help
            GPIO number for UART TX pin. See UART documentation for more information
            about available pin numbers for UART.

    config MB_UART_RTS
        int "UART RTS pin number"
        range 0 34 if IDF_TARGET_ESP32
        default 18 if IDF_TARGET_ESP32
        range 0 46 if IDF_TARGET_ESP32S2
        range 0 47 if IDF_TARGET_ESP32S3
        range 0 19 if IDF_TARGET_ESP32C3
        default 10 if IDF_TARGET_ESP32S2 || IDF_TARGET_ESP32S3 || IDF_TARGET_ESP32C3
        help
            GPIO number for UART RTS pin. This pin is connected to
            ~RE/DE pin of RS485 transceiver to switch direction.
            See UART documentation for more information about available pin
            numbers for UART.

    choice MB_COMM_MODE
        prompt "Modbus communication mode"
        default MB_COMM_MODE_RTU if CONFIG_FMB_COMM_MODE_RTU_EN
        help
            Selection of Modbus communication mode option for Modbus.

        config MB_COMM_MODE_RTU
            bool "RTU mode"
            depends on FMB_COMM_MODE_RTU_EN

        config MB_COMM_MODE_ASCII
            bool "ASCII mode"
            depends on FMB_COMM_MODE_ASCII_EN

    endchoice
endmenu
```
